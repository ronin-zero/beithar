## Config.in
```kconfig
if PACKAGE_syscall-sensors

config SYSCALL-SENSORS_CUSTOM
	bool "Development build (local source)"
	default n
	help
	  This is for the developers to make changes to the package source code
	  without having to download the entire thing from git-hub.

	  Unless you are one of the developers on the project, you want to leave this as 'n'
endif
```

## anomaly-detectors/Config.in
```kconfig
menu "Development Configuration"
	depends on PACKAGE_anomaly-detectors

config ANOMALY_DETECTORS_LOCAL
	bool "Development build (local source)"
	default n
	help
	  This is for the developers to make changes to the package source code
	  without having to download the entire thing from git-hub.

	  Unless you are one of the developers on the project, you want to leave this as 'n'

config ANOMALY_DETECTORS_LOCAL_SOURCE_PATH
	depends on ANOMALY_DETECTORS_LOCAL
	string "Local source location (directory)"
	help
	  List the directory where your local copy of the source code can be found.
	  For example: '/home/username/anomaly_detectors/'
	  The path should end with a trailing / and that directory could be the root of
	  where your source for the code is.

config ANOMALY_DETECTORS_GDB
	bool "Compile with support for GDB"
	select PACKAGE_gdb
	default n
	help
	  If you would like to run the program through GDB, enable this option.
	  This is no reason to enable this unless you are a developer on the project.

endmenu
```

## heimdall/Config.in
```kconfig
menu "Heimdall Program Suite Configuration"
    depends on PACKAGE_heimdall

config HEIMDALL_LOCAL
    bool "Use Local Source"
    default n
    help
        This is for the developers to make changes to the package source code
	    without having to download the entire thing from git-hub.

	    Unless you are one of the developers on the project, you want to leave this as 'n'

config HEIMDALL_LOCAL_SOURCE_PATH
    depends on HEIMDALL_LOCAL
    string "Local source location (directory)"
    help
        List the directory where your local copy of the source code can be found.
	    For example: '/home/username/heimdall/'
	    The path should end with a trailing / and that directory could be the root of
    	where your source for the code is.

endmenu
```

## heimdall/syscall-detector/Config.in
```kconfig
config SYSCALL-DETECTOR_GDB
    depends on PACKAGE_syscall-detector
    bool "Compile with support for GDB"
    select PACKAGE_gdb
    default n
    help
        If you would like to run the program through GDB, enable this option.
```

## heimdall/syscall-sensor/Config.in
```kconfig
config SYSCALL-SENSOR_GDB
    depends on PACKAGE_syscall-sensor
    bool "Compile with support for GDB"
    select PACKAGE_gdb
    select PACKAGE_gdbserver
    default n
    help
        If you would like to run the program through GDB, enable this option.

config SYSCALL-SENSOR_DEBUG_COUT
    depends on PACKAGE_syscall-sensor
    default n
    help
        Leave standard out, standard in, and standard error file descriptors
        open.  Useful when running as a daemon and trying to debug.
```

## syscall-sensors/Config.in
```kconfig
menu "Development Configuration"
	depends on PACKAGE_syscall-sensors

config SYSCALL-SENSORS_LOCAL
	bool "Development build (local source)"
	default n
	help
	  This is for the developers to make changes to the package source code
	  without having to download the entire thing from git-hub.

	  Unless you are one of the developers on the project, you want to leave this as 'n'

config SYSCALL-SENSORS_GDB
	bool "Compile with support for GDB"
	select PACKAGE_gdb
	default n
	help
	  If you would like to run the program through GDB, enable this option.
	  This is no reason to enable this unless you are a developer on the project.

endmenu
```
